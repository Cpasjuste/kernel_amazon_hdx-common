## drivers/input/touchscreen/synaptics_dsx/Kconfig
```kconfig
#
# Synaptics DSX touchscreen driver configuration
#
menuconfig TOUCHSCREEN_SYNAPTICS_DSX_SAT
	bool "Synaptics dsx True Touch touchscreens"
	default n
	help
	  Say Y here if you have a Synaptics DSX touchscreen connected
	  to your system.

	  If unsure, say N.

if TOUCHSCREEN_SYNAPTICS_DSX_SAT

choice
	default TOUCHSCREEN_SYNAPTICS_DSX_I2C_SAT
	prompt "Synaptics DSX touchscreen bus interface"
config TOUCHSCREEN_SYNAPTICS_DSX_I2C_SAT
	bool "I2C"
	depends on I2C
config TOUCHSCREEN_SYNAPTICS_DSX_SPI_SAT
	bool "SPI"
	depends on SPI_MASTER
endchoice

config TOUCHSCREEN_SYNAPTICS_DSX_CORE_SAT
	tristate "Synaptics DSX core driver module"
	depends on TOUCHSCREEN_SYNAPTICS_DSX_I2C_SAT || TOUCHSCREEN_SYNAPTICS_DSX_SPI_SAT
	help
	  Say Y here to enable basic touch reporting functionalities.

	  If unsure, say N.

	  To compile this driver as a module, choose M here: the
	  module will be called synaptics_dsx_core.

config TOUCHSCREEN_SYNAPTICS_DSX_RMI_DEV_SAT
	tristate "Synaptics DSX touchscreen RMI device module"
	depends on TOUCHSCREEN_SYNAPTICS_DSX_CORE_SAT
	help
	  Say Y here to enable support for direct RMI register access.

	  If unsure, say N.

	  To compile this driver as a module, choose M here: the
	  module will be called synaptics_dsx_rmi_dev.

config TOUCHSCREEN_SYNAPTICS_DSX_FW_UPDATE_SAT
	tristate "Synaptics DSX touchscreen firmware update module"
	depends on TOUCHSCREEN_SYNAPTICS_DSX_CORE_SAT
	help
	  Say Y here to enable support for carrying out firmware update.

	  If unsure, say N.

	  To compile this driver as a module, choose M here: the
	  module will be called synaptics_dsx_fw_update.

config TOUCHSCREEN_SYNAPTICS_DSX_TEST_REPORTING_SAT
	tristate "Synaptics DSX touchscreen test reporting module"
	depends on TOUCHSCREEN_SYNAPTICS_DSX_CORE_SAT
	help
	  Say Y here to enable support for retrieving self-test reports.

	  If unsure, say N.

	  To compile this driver as a module, choose M here: the
	  module will be called synaptics_dsx_test_reporting.
endif
```

## drivers/misc/analogix/Kconfig
```kconfig
config SLIMPORT_ANX3618
	tristate  "Analogix slimport driver support"
	default n
	help
	  Slimport Transmitter is a HD video transmitter chip
	  over micro-USB connector for smartphone device.
```
